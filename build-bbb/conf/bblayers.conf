## build-bbb/conf/bblayers.conf
```bitbake
# LAYER_CONF_VERSION is increased each time build/conf/bblayers.conf
# changes incompatibly
LCONF_VERSION = "6"

BBPATH = "${TOPDIR}"
BBFILES ?= ""

BBLAYERS ?= " \
  /home/hawk/work/yocto/yocto-base/meta-kongja-bbb \
  /home/hawk/work/yocto/yocto-base/meta-ti \
  /home/hawk/work/yocto/yocto-base/meta-qt5 \
  /home/hawk/work/yocto/yocto-base/poky/meta \
  /home/hawk/work/yocto/yocto-base/poky/meta-yocto \
  /home/hawk/work/yocto/yocto-base/meta-openembedded/meta-oe \
  /home/hawk/work/yocto/yocto-base/meta-openembedded/meta-networking \
  /home/hawk/work/yocto/yocto-base/meta-openembedded/meta-python \
  /home/hawk/work/yocto/yocto-base/meta-openembedded/meta-ruby \
  /home/hawk/work/yocto/yocto-base/meta-openembedded/meta-multimedia \
  "
BBLAYERS_NON_REMOVABLE ?= " \
  /home/hawk/work/yocto/yocto-base/poky/meta \
  /home/hawk/work/yocto/yocto-base/poky/meta-yocto \
  "
```
